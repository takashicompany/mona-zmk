## Kconfig
```kconfig
DT_COMPAT_ZMK_BEHAVIOR_BLE_INFO := zmk,behavior-ble-info

config ZMK_BEHAVIOR_BLE_INFO
    bool
    default $(dt_compat_enabled,$(DT_COMPAT_ZMK_BEHAVIOR_BLE_INFO))
    depends on ZMK_BLE && (!ZMK_SPLIT || ZMK_SPLIT_ROLE_CENTRAL)
    select BT_GATT_CLIENT
```

## config/west.yml
```yaml
manifest:
  remotes:
    - name: zmkfirmware
      url-base: https://github.com/zmkfirmware
    - name: sayu-hub
      url-base: https://github.com/sayu-hub
    - name: caksoylar  # <-- led
      url-base: https://github.com/caksoylar
  projects:
    - name: zmk
      remote: zmkfirmware
      revision: v0.3.0
      import: app/west.yml
    - name: zmk-pmw3610-driver  # <-- トラボドライバ
      remote: sayu-hub
      revision: main
    - name: zmk-rgbled-widget  # <-- led
      remote: caksoylar
      revision: v0.3.0
  self:
    path: config
```

## dts/bindings/behaviors/zmk,behavior-ble-info.yaml
```yaml
description: BLE Profile Info - outputs BLE profile status as HID keystrokes
compatible: "zmk,behavior-ble-info"
include: zero_param.yaml
```
