## behaviors/omni_scroll/Kconfig
```kconfig
config ZMK_BEHAVIOR_OMNI_SCROLL
    bool "Enable omnidirectional scroll behavior"
    default y
    depends on ZMK_POINTING
    help
        Enable the omnidirectional scroll behavior that automatically
        determines scroll direction (vertical or horizontal) based on
        trackball movement direction.
```

## config/Kconfig
```kconfig
# Omnidirectional scroll behavior configuration
config ZMK_BEHAVIOR_OMNI_SCROLL
    bool
    default y
    depends on ZMK_POINTING
    help
        Enable the omnidirectional scroll behavior that automatically
        determines scroll direction based on trackball movement.
```

## config/dts/bindings/behaviors/zmk,behavior-omni-scroll.yaml
```yaml
description: Omnidirectional scroll behavior

compatible: "zmk,behavior-omni-scroll"

properties:
  "#sensor-binding-cells":
    type: int
    const: 0
    required: false
  threshold:
    type: int
    default: 5
    description: Minimum movement magnitude to trigger scroll

  vertical-bias:
    type: int
    default: 15
    description: Vertical preference factor (x10, so 15 = 1.5)

  horizontal-bias:
    type: int
    default: 15
    description: Horizontal preference factor (x10, so 15 = 1.5)

  smoothing:
    type: int
    default: 3
    description: Number of samples for direction smoothing

  diagonal-threshold:
    type: int
    default: 30
    description: Angle threshold for diagonal detection (degrees)
```
